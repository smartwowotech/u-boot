## arch/arm/mach-s5pc1xx/Kconfig
```kconfig
if ARCH_S5PC1XX

choice
	prompt "S5PC1XX board select"
	optional

config TARGET_S5P_V210 
	bool "S5P Smdkv210 board"
	select OF_CONTROL

config TARGET_SMDKC100
	bool "Support smdkc100 board"
	select OF_CONTROL

endchoice

config SYS_SOC
	default "s5pc1xx"

source "board/samsung/smdkv210/Kconfig"
source "board/samsung/smdkc100/Kconfig"

endif
```

## board/samsung/smdkv210/Kconfig
```kconfig
#if TARGET_S5P_GONI
if TARGET_S5P_V210

config SYS_BOARD
	default "smdkv210"

config SYS_VENDOR
	default "samsung"

config SYS_SOC
	default "s5pc1xx"

config SYS_CONFIG_NAME
	default "s5p_v210"

endif
```
